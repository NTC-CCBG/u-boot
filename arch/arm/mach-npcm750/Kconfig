## arch/arm/mach-npcm750/Kconfig
```kconfig
if ARCH_NPCM750

choice
	prompt "NPCM board select"

config TARGET_POLEG
    bool "POLEG board"

endchoice


config SYS_SOC
	default "npcm750"


source "board/nuvoton/poleg/Kconfig"

endif
```

## board/nuvoton/poleg/Kconfig
```kconfig
if TARGET_POLEG

config SYS_BOARD
	default "poleg"

config SYS_VENDOR
	default "nuvoton"

config SYS_CONFIG_NAME
	default "poleg"


endif
```

## configs/PolegSVB_defconfig
```kconfig
CONFIG_ARM=y
CONFIG_ARCH_NPCM750=y
CONFIG_TARGET_POLEG=y
CONFIG_POLEG_SERIAL=y
CONFIG_DEFAULT_DEVICE_TREE="nuvoton-npcm750-evb"
CONFIG_SYS_TEXT_BASE=0x8200
CONFIG_NR_DRAM_BANKS=2
CONFIG_FIT=y
CONFIG_FIT_VERBOSE=y
CONFIG_MTD_DEVICE=y
CONFIG_MTD_PARTITIONS=y
# CONFIG_ENV_IS_IN_FLASH is not set
# CONFIG_CMD_FLASH is not set
CONFIG_CMD_SAVEENV=y
CONFIG_DM=y
CONFIG_DM_SERIAL=y
CONFIG_TIMER=y
CONFIG_CLK=y
CONFIG_OF_CONTROL=y
CONFIG_OF_LIBFDT=y
CONFIG_LIB_RAND=y
# CONFIG_EFI is not set
# CONFIG_EFI_LOADER is not set
# CONFIG_CMD_IMLS is not set
# CONFIG_CMD_XIMG is not set
CONFIG_SYS_NO_FLASH=y
# CONFIG_MMC is not set
# CONFIG_NETDEVICES is not set
CONFIG_CMD_UUID=y
```
